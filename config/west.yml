## config/west.yml
```yaml
manifest:
  remotes:
    - name: zmk
      url-base: https://github.com/zmkfirmware
    - name: badjeff
      url-base: https://github.com/badjeff
    - name: yangxing
      url-base: https://github.com/yangxing844
  projects:
    - name: zmk
      remote: zmk
      revision: abb64ba316c29caddc49727ca2cac2f0ed5970c7
      import: app/west.yml
    - name: zmk-pmw3610-driver
      remote: badjeff
      revision: 77635ba
    - name: zmk-split-peripheral-input-relay
      remote: badjeff
      revision: f49a5ca
    - name: zmk-input-behavior-listener
      remote: badjeff
      revision: 80fc270
    - name: zmk-lpm009m360a-driver
      remote: yangxing
      revision: b5e5acd
  self:
    path: config
```
